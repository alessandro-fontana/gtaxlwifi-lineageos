/dts-v1/;

/ {
	compatible = "samsung,exynos7870";
	#address-cells = <2>;
	#size-cells = <1>;

	model_info-chip = <7870>;
	model_info-hw_rev = <0>;
	model_info-hw_rev_end = <255>;

	chosen {
	};

	memory@80000000 {
		device_type = "memory";
		reg = <0x0 0x80000000 0x0>;
	};

	memory@100000000 {
		device_type = "memory";
		reg = <0x1 0x00000000 0x0>;
	};
};
